## conf/layer.conf
```bitbake
#
# Copyright (C) 2015 Wind River Systems, Inc.
#
BBPATH ?= ""
# We have a conf and classes directory, add to BBPATH
BBPATH .= ":${LAYERDIR}"

# We have a packages directory, add to BBFILES
BBFILES += "${LAYERDIR}/recipes-*/*/*.bb \
	${LAYERDIR}/recipes-*/*/*.bbappend \
	${LAYERDIR}/classes/*.bbclass \
	${LAYERDIR}/master-meta-oe/classes/*.bbclass"

BBFILE_COLLECTIONS += "wrlabs-integration"
BBFILE_PATTERN_wrlabs-integration := "^${LAYERDIR}/"
BBFILE_PRIORITY_wrlabs-integration = "20"

# Common licenses used by some packages in this layer
LICENSE_PATH += "${LAYERDIR}/files/common-licenses"

# This should only be incremented on significant changes that will
# cause compatibility issues with other layers
LAYERVERSION_wrlabs-integration = "1"

# Define WR sample keys
WR_SAMPLE_MOK_SB_KEYS_DIR = "${LAYERDIR}/files/sample-keys/mok_sb_keys"
WR_SAMPLE_UEFI_SB_KEYS_DIR = "${LAYERDIR}/files/sample-keys/uefi_sb_keys"
WR_SAMPLE_SYSTEM_TRUSTED_KEYS_DIR = "${LAYERDIR}/files/sample-keys/system_trusted_keys"
WR_SAMPLE_IMA_KEYS_DIR = "${LAYERDIR}/files/sample-keys/ima_keys"
WR_SAMPLE_RPM_KEYS_DIR = "${LAYERDIR}/files/sample-keys/rpm_keys"
```

## scripts/lib/wic/canned-wks/cube-desktop-ostree-runtime-intel-corei7-64-luks.wks
```
part / --source rawcopy --sourceparams="file=cube-desktop-ostree-runtime-intel-corei7-64_efi.otaimg"  --ondisk mmcblk --fstype=vfat --label otaefi --active --align 4
part / --source rawcopy --sourceparams="file=cube-desktop-ostree-runtime-intel-corei7-64_boot.otaimg" --ondisk mmcblk --fstype=ext4 --label otaboot --align 4
part / --source rawcopy --sourceparams="file=cube-desktop-ostree-runtime-intel-corei7-64.otaimg" --ondisk mmcblk --fstype=ext4 --label luksotaroot --align 4
part / --source rawcopy --sourceparams="file=cube-desktop-ostree-runtime-intel-corei7-64_var.otaimg"  --ondisk mmcblk --fstype=ext4 --label luksfluxdata --active --align 4
```

## scripts/lib/wic/canned-wks/cube-gw-ostree-runtime-intel-corei7-64-luks.wks
```
part /boot/efi --source rawcopy --sourceparams="file=cube-gw-ostree-runtime-intel-corei7-64_efi.otaimg"  --ondisk sda --fstype=vfat --label otaefi --active --align 4
part /boot --source rawcopy --sourceparams="file=cube-gw-ostree-runtime-intel-corei7-64_boot.otaimg" --ondisk sda --fstype=ext4 --label otaboot --align 4 --type logical
part / --source rawcopy --sourceparams="file=cube-gw-ostree-runtime-intel-corei7-64.otaimg" --ondisk sda --fstype=ext4 --label luksotaroot --align 4 --type logical
part /boot --source rawcopy --sourceparams="file=cube-gw-ostree-runtime-intel-corei7-64_boot.otaimg" --ondisk sda --fstype=ext4 --label otaboot_b --align 4 --type logical
part / --source rawcopy --sourceparams="file=cube-gw-ostree-runtime-intel-corei7-64.otaimg" --ondisk sda --fstype=ext4 --label luksotaroot_b --align 4 --type logical
part /var --source rawcopy --sourceparams="file=cube-gw-ostree-runtime-intel-corei7-64_var.otaimg"  --ondisk sda --fstype=ext4 --label luksfluxdata --align 4
```

## scripts/lib/wic/canned-wks/cube-gw-ostree-runtime-intel-corei7-64.wks
```
part /boot/efi --source rawcopy --sourceparams="file=cube-gw-ostree-runtime-intel-corei7-64_efi.otaimg"  --ondisk sda --fstype=vfat --label otaefi --active --align 4
part / --source rawcopy --sourceparams="file=cube-gw-ostree-runtime-intel-corei7-64_boot.otaimg" --ondisk sda --fstype=ext4 --label otaboot --align 4 --type logical
part / --source rawcopy --sourceparams="file=cube-gw-ostree-runtime-intel-corei7-64.otaimg" --ondisk sda --fstype=ext4 --label otaroot --align 4 --type logical
part / --source rawcopy --sourceparams="file=cube-gw-ostree-runtime-intel-corei7-64_boot.otaimg" --ondisk sda --fstype=ext4 --label otaboot_b --align 4 --type logical
part / --source rawcopy --sourceparams="file=cube-gw-ostree-runtime-intel-corei7-64.otaimg" --ondisk sda --fstype=ext4 --label otaroot_b --align 4 --type logical
part /var --source rawcopy --sourceparams="file=cube-gw-ostree-runtime-intel-corei7-64_var.otaimg"  --ondisk sda --fstype=ext4 --label fluxdata --active --align 4
```

## scripts/lib/wic/canned-wks/seco-image-minimal-ostree-runtime-nxp-imx6.wks
```
part / --source rawcopy --sourceparams="file=u-boot.imx" --ondisk mmcblk --no-table --align 1 --size 1
part /boot --source bootimg-partition --ondisk mmcblk --fstype=vfat --label boot --active --align 4 --size 16
part / --source rawcopy --sourceparams="file=seco-image-minimal-ostree-runtime-nxp-imx6_boot.otaimg" --ondisk mmcblk --fstype=ext4 --label otaboot --align 4 --type logical
part / --source rawcopy --sourceparams="file=seco-image-minimal-ostree-runtime-nxp-imx6.otaimg" --ondisk mmcblk --fstype=ext4 --label otaroot --align 4 --type logical
part / --source rawcopy --sourceparams="file=seco-image-minimal-ostree-runtime-nxp-imx6_boot.otaimg" --ondisk mmcblk --fstype=ext4 --label otaboot_b --align 4 --type logical
part / --source rawcopy --sourceparams="file=seco-image-minimal-ostree-runtime-nxp-imx6.otaimg" --ondisk mmcblk --fstype=ext4 --label otaroot_b --align 4 --type logical
part /var --source rawcopy --sourceparams="file=seco-image-minimal-ostree-runtime-nxp-imx6_var.otaimg"  --ondisk mmcblk --fstype=ext4 --label fluxdata --active --align 4
```
